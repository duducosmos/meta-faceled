## conf/layer.conf
```bitbake
# We have a conf and classes directory, add to BBPATH
BBPATH .= ":${LAYERDIR}"

# We have recipes-* directories, add to BBFILES
BBFILES += "${LAYERDIR}/recipes-*/*/*.bb \
            ${LAYERDIR}/recipes-*/*/*.bbappend"

BBFILE_COLLECTIONS += "meta-faceled"
BBFILE_PATTERN_meta-faceled = "^${LAYERDIR}/"
BBFILE_PRIORITY_meta-faceled = "6"

LAYERDEPENDS_meta-faceled = "core"
LAYERSERIES_COMPAT_meta-faceled = "dunfell"
IMAGE_INSTALL_append += " python3 python3-setuptools python3-pip python3-opencv "
```
